## driver/LKM/Kconfig
```kconfig
#
## Bytedance module configuration
#
config ELKEID
        tristate "bytedance HIDS module - ELKEID"
        depends on KPROBES && KRETPROBES
	default m
        help
		ByteDance ELKEID/HIDS kernel module
		Project: https://github.com/bytedance/elkeid
```
